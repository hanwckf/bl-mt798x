## atf-20250711/plat/mediatek/mt7622/drivers/dram/Config.in
```kconfig
# SPDX-License-Identifier: BSD-3-Clause
#
# Copyright (c) 2023, MediaTek Inc. All rights reserved.
# Author: Weijie Gao <weijie.gao@mediatek.com>
#
# MT7622 DRAM-pecific configurations
#

if _PLAT_MT7622

config _MT7622_DDR3_FLYBY
	bool "Enable Fly-by topology (Uses 2x DDR3 chips)"
	default n

# Makefile option
config DDR3_FLYBY
	int
	default 1
	depends on _MT7622_DDR3_FLYBY

endif # _PLAT_MT7622
```

## atf-20250711/plat/mediatek/mt7981/drivers/dram/Config.in
```kconfig
# SPDX-License-Identifier: BSD-3-Clause
#
# Copyright (c) 2023, MediaTek Inc. All rights reserved.
# Author: Weijie Gao <weijie.gao@mediatek.com>
#
# MT7981 DRAM-pecific configurations
#

if _PLAT_MT7981

choice
	prompt "Chip package"

	config _MT7981_BOARD_QFN
		bool "QFN"
		depends on _DRAM_DDR3

	config _MT7981_BOARD_BGA
		bool "BGA"
endchoice

# Makefile options
config BOARD_QFN
	int
	default 1
	depends on _MT7981_BOARD_QFN

config BOARD_BGA
	int
	default 1
	depends on _MT7981_BOARD_BGA

endif # _PLAT_MT7981
```

## atf-20250711/plat/mediatek/mt7987/drivers/dram/Config.in
```kconfig
# SPDX-License-Identifier: BSD-3-Clause
#
# Copyright (c) 2023, MediaTek Inc. All rights reserved.
# Author: Weijie Gao <weijie.gao@mediatek.com>
#
# MT7987 DRAM-pecific configurations
#

if _PLAT_MT7987

config _MT7987_DDR4_4GB
	bool "Support DDR4 4GB (16-bits)"
	default n

# Makefile options
config DDR4_4BG_MODE
	int
	default 1
	depends on _MT7987_DDR4_4GB

endif # _PLAT_MT7987
```

## atf-20250711/plat/mediatek/mt7988/Config.in
```kconfig
# SPDX-License-Identifier: BSD-3-Clause
#
# Copyright (c) 2023, MediaTek Inc. All rights reserved.
# Author: Weijie Gao <weijie.gao@mediatek.com>
#
# MT7988 platform-specific configurations
#

if _PLAT_MT7988

config _ENABLE_EIP197_SUPPORT
	bool "Enable EIP197 support"
	default n

config _ENABLE_BL2_CPU_FULL_SPEED
	bool "Enable BL2 CPU full speed mode"
	select _ENABLE_I2C_SUPPORT
	default n

config _ENABLE_FWDL
	bool "Enable BL31 FWDL SMCC"
	select _REQUIRE_MBEDTLS
	default n

# Makefile options
config EIP197_SUPPORT
	int
	default 1
	depends on _ENABLE_EIP197_SUPPORT

config BL2_CPU_FULL_SPEED
	int
	default 1
	depends on _ENABLE_BL2_CPU_FULL_SPEED

config FWDL
	int
	default 1
	depends on _ENABLE_FWDL

osource "plat/mediatek/mt7988/drivers/fwdl/Config.in"

endif # _PLAT_MT7988
```

## atf-20250711/plat/mediatek/mt7988/drivers/dram/Config.in
```kconfig
# SPDX-License-Identifier: BSD-3-Clause
#
# Copyright (c) 2023, MediaTek Inc. All rights reserved.
# Author: Weijie Gao <weijie.gao@mediatek.com>
#
# MT7988 DRAM-pecific configurations
#

if _PLAT_MT7988

config _MT7988_DDR4_8GB
	bool "Support DDR4 8GB (2x16-bits) / 4GB (1x16-bits)"
	depends on _DRAM_DDR_COMB || _DRAM_DDR4
	default n

# Makefile options
config DDR4_4BG_MODE
	int
	default 1
	depends on _MT7988_DDR4_8GB

endif # _PLAT_MT7988
```

## uboot-mtk-20220606/board/mediatek/common/Kconfig
```kconfig
config MEDIATEK_BOOTMENU
	bool "Enable MediaTek bootmenu framework"
	select CMD_BOOTMENU
	select CMD_BOOTMENU_ENTER_UBOOT_CONSOLE
	select UTF16_STRING_SUPPORT
	select PARTITIONS
	default n
	help
	  Enable this option will allow boards to use a bootmenu containing
	  features for easy upgrading/booting.

config MEDIATEK_BOOTMENU_COUNTDOWN
	bool "Enable bootmenu countdown"
	default y
	depends on MEDIATEK_BOOTMENU
	help
	  Enable bootmenu auto-booting countdown timer.

config MEDIATEK_BOOTMENU_DELAY
	int "MediaTek bootmenu delay time (s)"
	range 1 10
	default 4
	depends on MEDIATEK_BOOTMENU_COUNTDOWN
	help
	  The dealy seconds for the bootmenu to show before running the
	  default command.

config MEDIATEK_LOAD_FROM_RAM
	bool "Enable loading from RAM support"
	default n
	depends on MEDIATEK_BOOTMENU
	help
	  Enable loading from RAM support for mtkload and mtkupgrade. This is
	  useful when using JTAG debugging and ethernet is not available.

config MTK_SECURE_BOOT
	bool "Enable MediaTek secure boot framework"
	select FIT_SIGNATURE
	select RSA
	select RSA_VERIFY
	select ENV_IS_NOWHERE if !MTK_DUAL_BOOT
	select CHAIN_OF_TRUST if !MTK_DUAL_BOOT
	select IMAGE_FORCED_VERIFY
	select FDT_NO_BOOTARGS_OVERRIDE
	default n
	help
	  Enable this option will allow boards to verify Linux and Filesystem.

config CHAIN_OF_TRUST
	bool
	default n

config MTK_ANTI_ROLLBACK
	bool "Enable MediaTek anti-rollback framework"
	default n
	depends on MTK_SECURE_BOOT
	help
	  Enable this option will allow boards to verify Firmware Anti-rollback
	  Version.

config MTK_UPGRADE_IMAGE_VERIFY
	bool "Verify firmware image before upgrading"
	select FIT
	default y
	help
	  Enable this option will force to verify the image being upgraded.
	  Upgrading UBI raw partition image and UBI hybrid image will be
	  rejected.

config MTK_UPGRADE_IMAGE_ROOTFS_VERIFY
	bool "Verify rootfs part"
	depends on MTK_UPGRADE_IMAGE_VERIFY
	default y if MTK_DUAL_BOOT
	default n
	help
	  Enable this option will force to verify the rootfs part of the image.
	  The rootfs hash should be embedded into the FIT image.
	  If no such hash found, verification will fail.

config SUPPORT_MTK_DUAL_BOOT
	bool
	default n

config MTK_DUAL_BOOT
	bool "Enable A/B System Updates"
	depends on SUPPORT_MTK_DUAL_BOOT
	help
	  A/B system updates ensure a workable booting system remains on the
	  flash device during an firmware upgrading.

config MTK_DUAL_BOOT_IMAGE_ROOTFS_VERIFY
	bool "Verify rootfs part"
	depends on MTK_DUAL_BOOT
	default y
	help
	  Enable this option will force to verify the rootfs part of the image.
	  The rootfs hash should be embedded into the FIT image.
	  If no such hash found, verification will fail.

config MTK_DUAL_BOOT_SLOT_1_KERNEL_NAME
	string "Name for kernel of image slot 1"
	depends on MTK_DUAL_BOOT
	default "kernel2"
	help
	  The partition/volume name for kernel of image slot 1

config MTK_DUAL_BOOT_SLOT_1_ROOTFS_NAME
	string "Name for rootfs of image slot 1"
	depends on MTK_DUAL_BOOT
	default "rootfs2"
	help
	  The partition/volume name for rootfs of image slot 1

config MTK_DUAL_BOOT_SHARED_ROOTFS_DATA
	bool "Use shared rootfs_data for both images"
	depends on MTK_DUAL_BOOT
	default y

config MTK_DUAL_BOOT_ROOTFS_DATA_NAME
	string "Name for rootfs_data of both image slots"
	depends on MTK_DUAL_BOOT_SHARED_ROOTFS_DATA
	default "rootfs_data"
```

## uboot-mtk-20220606/board/mediatek/mt7629/Kconfig
```kconfig
if TARGET_MT7629

config SYS_BOARD
	default "mt7629"

config SYS_CONFIG_NAME
	default "mt7629"

config MTK_SPL_PAD_SIZE
	hex
	default 0x10000

config MTK_BROM_HEADER_INFO
	string
	default "media=nor" if BOOT_FROM_SNOR
	default "media=snand;nandinfo=2k+64" if BOOT_FROM_SNAND_2K_64
	default "media=snand;nandinfo=2k+128" if BOOT_FROM_SNAND_2K_128
	default "media=snand;nandinfo=4k+128" if BOOT_FROM_SNAND_4K_128
	default "media=snand;nandinfo=4k+256" if BOOT_FROM_SNAND_4K_256

choice
	prompt "Boot device"
	default BOOT_FROM_SNOR

config BOOT_FROM_SNOR
	bool "SPI-NOR"

config BOOT_FROM_SNAND_2K_64
	bool "SPI-NAND (2K+64)"
	select MT7629_BOOT_FROM_SNAND

config BOOT_FROM_SNAND_2K_128
	bool "SPI-NAND (2K+128)"
	select MT7629_BOOT_FROM_SNAND

config BOOT_FROM_SNAND_4K_128
	bool "SPI-NAND (4K+128)"
	select MT7629_BOOT_FROM_SNAND

config BOOT_FROM_SNAND_4K_256
	bool "SPI-NAND (4K+256)"
	select MT7629_BOOT_FROM_SNAND

endchoice

config MT7629_BOOT_FROM_SNAND
	bool
	default n

if MT7629_BOOT_FROM_SNAND

config ENABLE_NAND_NMBM
	bool "Enable NAND bad block mapping management"
	default n
	select MTD_DEVICE
	select NMBM
	select NMBM_MTD
	help
	  Select this if you want to use bad block management to handle
	  bad blocks marked druing factory production, and to handle new
	  bad blocks during use.
	  Enabling this option will create a MTD translation layer on
	  the original MTD of the NAND device.

config NMBM_MAX_RATIO
	int "Default ratio for reserved block for management (N/16)"
	range 1 8
	default 1
	depends on ENABLE_NAND_NMBM
	help
	  This option determines how many blocks at the high adress of NAND
	  can be used for NMBM. For a large size NAND, 1/16 of total blocks
	  are still too large for NMBM. For this situation please set
	  CONFIG_NMBM_MAX_BLOCKS to a proper value to limit the maximum
	  reserved blocks.

config NMBM_MAX_BLOCKS
	int "Maximum blocks allowed for reserved block for management"
	range 32 2147483647
	default 256
	depends on ENABLE_NAND_NMBM
	help
	  This option is applied after NMBM_MAX_RATIO to ensure maximum
	  blocks reserved block for NMBM will not exceed the value set by
	  this option.

endif

source "board/mediatek/common/Kconfig"

choice
	prompt "Device type for bootmenu"
	default MT7629_BOOTMENU_SNAND
	depends on MEDIATEK_BOOTMENU

config MT7629_BOOTMENU_SNOR
	bool "SPI-NOR"
	depends on !MT7629_BOOT_FROM_SNAND

config MT7629_BOOTMENU_SNOR_SB
	bool "SPI-NOR (with ATF)"
	depends on !MT7629_BOOT_FROM_SNAND

config MT7629_BOOTMENU_SNAND
	bool "SPI-NAND"
	depends on MT7629_BOOT_FROM_SNAND

config MT7629_BOOTMENU_SNAND_SB
	bool "SPI-NAND (with ATF)"
	depends on MT7629_BOOT_FROM_SNAND

endchoice

endif
```

## uboot-mtk-20220606/board/mediatek/mt7988/Kconfig
```kconfig
if TARGET_MT7988

config SYS_BOARD
	default "mt7988"

config SYS_CONFIG_NAME
	default "mt7988"

config MTK_BROM_HEADER_INFO
	string
	default "lk=1"

config MTK_BROM_HEADER_INFO
	string
	default "media=nor"

config ENABLE_NAND_NMBM
    bool "Enable NAND bad block mapping management"
    default n
    select MTD_DEVICE
    select NMBM
    select NMBM_MTD
    help
      Select this if you want to use bad block management to handle
      bad blocks marked druing factory production, and to handle new
      bad blocks during use.
      Enabling this option will create a MTD translation layer on
      the original MTD of the NAND device.

config NMBM_MAX_RATIO
    int "Default ratio for reserved block for management (N/16)"
    range 1 8
    default 1
    depends on ENABLE_NAND_NMBM
    help
      This option determines how many blocks at the high adress of NAND
      can be used for NMBM. For a large size NAND, 1/16 of total blocks
      are still too large for NMBM. For this situation please set
      CONFIG_NMBM_MAX_BLOCKS to a proper value to limit the maximum
      reserved blocks.

config NMBM_MAX_BLOCKS
    int "Maximum blocks allowed for reserved block for management"
    range 32 2147483647
    default 256
    depends on ENABLE_NAND_NMBM
    help
      This option is applied after NMBM_MAX_RATIO to ensure maximum
      blocks reserved block for NMBM will not exceed the value set by
      this option.

source "board/mediatek/common/Kconfig"

choice
	prompt "Device type for bootmenu"
	default MT7988_BOOTMENU_SNAND
	depends on MEDIATEK_BOOTMENU

config MT7988_BOOTMENU_SNOR
	bool "SPI-NOR"

config MT7988_BOOTMENU_SNAND
	bool "SPI-NAND"

config MT7988_BOOTMENU_EMMC
	bool "eMMC"

config MT7988_BOOTMENU_SD
	bool "SD"

config MT7988_BOOTMENU_UBI
	bool "UBI"
	select MTD
	select MTD_PARTITIONS
	select MTD_UBI
	help
	  This is intended for using UBI built on the top of MTD devices.
	  Generally you should select this instead of SPI-NAND for new design
	  in order to extend the lifecycle of NAND devices.
	  By selecting this you should specify mtdparts in environment.
endchoice

config MEDIATEK_UBI_FIXED_MTDPARTS
	bool "Do not allow mtdparts to be changed by user"
	depends on MT7988_BOOTMENU_UBI
	help
	  Enable this option if you do not want the user to change the
	  mtdparts which lead to unexpceted results such as missing ubi
	  partition or changing ubi partition to a different offset.

endif
```

## uboot-mtk-20220606/configs/gl_mt2500_defconfig
```kconfig
CONFIG_ARM=y
CONFIG_POSITION_INDEPENDENT=y
CONFIG_ARCH_MEDIATEK=y
CONFIG_SYS_TEXT_BASE=0x41e00000
CONFIG_SYS_MALLOC_F_LEN=0x4000
CONFIG_NR_DRAM_BANKS=1
CONFIG_ENV_SIZE=0x80000
CONFIG_ENV_OFFSET=0x400000
CONFIG_DEFAULT_DEVICE_TREE="gl-mt2500"
CONFIG_TARGET_MT7981=y
CONFIG_MEDIATEK_BOOTMENU=y
CONFIG_MEDIATEK_LOAD_FROM_RAM=y
CONFIG_MT7981_BOOTMENU_EMMC=y
CONFIG_DEBUG_UART_BASE=0x11002000
CONFIG_DEBUG_UART_CLOCK=40000000
CONFIG_DEBUG_UART=y
CONFIG_SYS_LOAD_ADDR=0x46000000
CONFIG_FIT=y
# CONFIG_AUTOBOOT_MENU_SHOW is not set
# CONFIG_AUTOBOOT_MENU_MTK_SHOW is not set
CONFIG_DEFAULT_FDT_FILE="gl-mt2500"
CONFIG_LOGLEVEL=7
CONFIG_LOG=y
CONFIG_SYS_PROMPT="MT7981> "
CONFIG_CMD_GPIO=y
CONFIG_CMD_PWM=y
CONFIG_CMD_GPT=y
CONFIG_CMD_GPT_RENAME=y
CONFIG_CMD_MMC=y
CONFIG_CMD_PART=y
CONFIG_CMD_PCI=y
CONFIG_CMD_READ=y
CONFIG_CMD_PING=y
CONFIG_CMD_SMC=y
CONFIG_CMD_FAT=y
CONFIG_CMD_FS_GENERIC=y
# CONFIG_DOS_PARTITION is not set
CONFIG_PARTITION_TYPE_GUID=y
CONFIG_OF_EMBED=y
CONFIG_ENV_OVERWRITE=y
CONFIG_ENV_IS_IN_MMC=y
CONFIG_ENV_VARS_UBOOT_RUNTIME_CONFIG=y
CONFIG_NET_RANDOM_ETHADDR=y
CONFIG_REGMAP=y
CONFIG_SYSCON=y
CONFIG_CLK=y
CONFIG_SYS_I2C_MTK=y
CONFIG_SUPPORT_EMMC_BOOT=y
CONFIG_MMC_HS200_SUPPORT=y
CONFIG_MMC_MTK=y
CONFIG_PHY_FIXED=y
CONFIG_DM_ETH=y
CONFIG_MEDIATEK_ETH=y
CONFIG_PCI=y
CONFIG_PCIE_MEDIATEK=y
CONFIG_PINCTRL=y
CONFIG_PINCONF=y
CONFIG_PINCTRL_MT7981=y
CONFIG_POWER_DOMAIN=y
CONFIG_MTK_POWER_DOMAIN=y
CONFIG_DM_REGULATOR=y
CONFIG_DM_REGULATOR_FIXED=y
CONFIG_DM_PWM=y
CONFIG_PWM_MTK=y
CONFIG_RAM=y
CONFIG_DM_SERIAL=y
CONFIG_MTK_SERIAL=y
CONFIG_SPI=y
CONFIG_DM_SPI=y
CONFIG_TIMER=y
CONFIG_MTK_TIMER=y
CONFIG_LZO=y
CONFIG_HEXDUMP=y
CONFIG_WEBUI_FAILSAFE=y
CONFIG_BUTTON=y
CONFIG_BUTTON_GPIO=y
CONFIG_LED=y
CONFIG_LED_GPIO=y
CONFIG_LED_BLINK=y
# CMD_CONSOLE is not set
# CONFIG_BOOTM_NETBSD is not set
# CONFIG_BOOTM_PLAN9 is not set
# CONFIG_BOOTM_RTEMS is not set
# CONFIG_BOOTM_VXWORKS is not set
# CONFIG_CMD_BOOTEFI is not set
# CONFIG_CMD_FDT is not set
# CONFIG_CMD_UNLZ4 is not set
# CONFIG_CMD_UNZIP is not set
# CONFIG_CMD_FLASH is not set
# CONFIG_CMD_NAND_EXT is not set
# CONFIG_CMD_SF is not set
# CONFIG_CMD_NFS is not set
# CONFIG_INPUT is not set
CONFIG_AUTOBOOT_KEYED=y
CONFIG_AUTOBOOT_PROMPT="Enter \"gl\" to stop autoboot in %d seconds\n"
CONFIG_AUTOBOOT_STOP_STR="gl"
CONFIG_POLLER=y
CONFIG_ENV_VARS_UBOOT_CONFIG=y
CONFIG_ENV_IMPORT_FDT=y
CONFIG_CMD_GL_BTN=y
CONFIG_CMD_LED_BLINK=y
CONFIG_HUSH_PARSER=y
CONFIG_ARP_TIMEOUT=1000
CONFIG_NET_RETRY_COUNT=3
```

## uboot-mtk-20220606/configs/mt7622_nmbm_sb_rfb_defconfig
```kconfig
CONFIG_ARM=y
CONFIG_POSITION_INDEPENDENT=y
CONFIG_ARCH_MEDIATEK=y
CONFIG_SYS_TEXT_BASE=0x41e00000
CONFIG_SYS_MALLOC_F_LEN=0x4000
CONFIG_NR_DRAM_BANKS=1
CONFIG_ENV_SIZE=0x20000
CONFIG_DEFAULT_DEVICE_TREE="mt7622-rfb"
CONFIG_ENABLE_NAND_NMBM=y
CONFIG_MEDIATEK_BOOTMENU=y
CONFIG_MTK_SECURE_BOOT=y
CONFIG_DEBUG_UART_BASE=0x11002000
CONFIG_DEBUG_UART_CLOCK=25000000
CONFIG_DEBUG_UART=y
CONFIG_SYS_LOAD_ADDR=0x4007ff28
CONFIG_FIT=y
CONFIG_AUTOBOOT_MENU_SHOW=y
CONFIG_AUTOBOOT_MENU_MTK_SHOW=y
CONFIG_DEFAULT_FDT_FILE="mt7622-rfb"
CONFIG_LOGLEVEL=7
CONFIG_LOG=y
CONFIG_SYS_PROMPT="MT7622> "
# CONFIG_BOOTM_NETBSD is not set
# CONFIG_BOOTM_PLAN9 is not set
# CONFIG_BOOTM_RTEMS is not set
# CONFIG_BOOTM_VXWORKS is not set
# CONFIG_CMD_ELF is not set
CONFIG_CMD_DM=y
# CONFIG_CMD_FLASH is not set
CONFIG_CMD_GPIO=y
CONFIG_CMD_MMC=y
CONFIG_CMD_MTD=y
CONFIG_CMD_NMBM=y
CONFIG_CMD_PCI=y
CONFIG_CMD_PING=y
CONFIG_CMD_SMC=y
CONFIG_DOS_PARTITION=y
CONFIG_EFI_PARTITION=y
CONFIG_PARTITION_TYPE_GUID=y
CONFIG_NET_RANDOM_ETHADDR=y
CONFIG_REGMAP=y
CONFIG_SYSCON=y
CONFIG_CLK=y
CONFIG_MMC_HS200_SUPPORT=y
CONFIG_MMC_MTK=y
CONFIG_MTD=y
CONFIG_DM_MTD=y
CONFIG_MTK_SPI_NAND=y
CONFIG_MTK_SPI_NAND_MTD=y
CONFIG_PHY_FIXED=y
CONFIG_DM_ETH=y
CONFIG_MEDIATEK_ETH=y
CONFIG_PCI=y
CONFIG_PCIE_MEDIATEK=y
CONFIG_PINCTRL=y
CONFIG_PINCONF=y
CONFIG_PINCTRL_MT7622=y
CONFIG_POWER_DOMAIN=y
CONFIG_MTK_POWER_DOMAIN=y
CONFIG_DM_SERIAL=y
CONFIG_MTK_SERIAL=y
CONFIG_LZO=y
CONFIG_HEXDUMP=y
# CONFIG_EFI_LOADER is not set
```
