## uboot-mtk-20250711/board/mediatek/common/customizations/Kconfig
```kconfig
menuconfig MTK_MISC_CUSTOMIZED
	bool "Enable misc customized features support"
	help
	  This option enabled mediatek misc customized features support

if MTK_MISC_CUSTOMIZED

config MTK_COLOR_LED
	bool "Enable color led program (cled)"
	default n
	select PWM_MTK
	select CYCLIC
	help
	  Select this if you want to build mediatek color led program

endif #MTK_MISC_CUSTOMIZED
```

## uboot-mtk-20250711/board/mediatek/mt7629/Kconfig
```kconfig
if TARGET_MT7629

config MTK_BROM_HEADER_INFO
	string
	default "media=nor" if BOOT_FROM_SNOR
	default "media=snand;nandinfo=2k+64" if BOOT_FROM_SNAND_2K_64
	default "media=snand;nandinfo=2k+128" if BOOT_FROM_SNAND_2K_128
	default "media=snand;nandinfo=4k+128" if BOOT_FROM_SNAND_4K_128
	default "media=snand;nandinfo=4k+256" if BOOT_FROM_SNAND_4K_256

choice
	prompt "Boot device"
	default BOOT_FROM_SNOR

config BOOT_FROM_SNOR
	bool "SPI-NOR"

config BOOT_FROM_SNAND_2K_64
	bool "SPI-NAND (2K+64)"
	select MT7629_BOOT_FROM_SNAND

config BOOT_FROM_SNAND_2K_128
	bool "SPI-NAND (2K+128)"
	select MT7629_BOOT_FROM_SNAND

config BOOT_FROM_SNAND_4K_128
	bool "SPI-NAND (4K+128)"
	select MT7629_BOOT_FROM_SNAND

config BOOT_FROM_SNAND_4K_256
	bool "SPI-NAND (4K+256)"
	select MT7629_BOOT_FROM_SNAND

endchoice

config MT7629_BOOT_FROM_SNAND
	bool
	default n

endif
```

## uboot-mtk-20250711/configs/mt7981_cmcc_rax3000m-emmc_defconfig
```kconfig
CONFIG_ARM=y
CONFIG_SYS_HAS_NONCACHED_MEMORY=y
CONFIG_POSITION_INDEPENDENT=y
CONFIG_ARCH_MEDIATEK=y
CONFIG_TEXT_BASE=0x41e00000
CONFIG_SYS_MALLOC_F_LEN=0x4000
CONFIG_NR_DRAM_BANKS=1
CONFIG_ENV_SIZE=0x80000
CONFIG_ENV_OFFSET=0x400000
CONFIG_DEFAULT_DEVICE_TREE="mt7981-cmcc-rax3000m-emmc"
CONFIG_SYS_PROMPT="MT7981> "
CONFIG_TARGET_MT7981=y
CONFIG_DEBUG_UART_BASE=0x11002000
CONFIG_DEBUG_UART_CLOCK=40000000
CONFIG_SYS_LOAD_ADDR=0x46000000
CONFIG_DEBUG_UART=y
CONFIG_MEDIATEK_BOOTMENU=y
CONFIG_MTK_BOOTMENU_MMC=y
CONFIG_MEDIATEK_BOOTMENU_DELAY=3
CONFIG_MTK_WEB_FAILSAFE=y
CONFIG_MTK_WEB_FAILSAFE_AFTER_BOOT_FAILURE=y
CONFIG_MTK_UPGRADE_BL2_VERIFY=y
CONFIG_MTK_UPGRADE_FIP_VERIFY=y
# CONFIG_MTK_UPGRADE_IMAGE_VERIFY is not set
CONFIG_ENV_VARS_UBOOT_CONFIG=y
CONFIG_FIT=y
CONFIG_BOOTDELAY=3
CONFIG_AUTOBOOT_MENU_SHOW=y
CONFIG_AUTOBOOT_MENU_MTK_SHOW=y
CONFIG_DEFAULT_FDT_FILE="mt7981-emmc-rfb"
CONFIG_LOGLEVEL=7
CONFIG_LOG=y
CONFIG_HUSH_PARSER=y
CONFIG_SYS_CBSIZE=512
CONFIG_SYS_PBSIZE=1049
# CONFIG_BOOTM_NETBSD is not set
# CONFIG_BOOTM_PLAN9 is not set
# CONFIG_BOOTM_RTEMS is not set
# CONFIG_BOOTM_VXWORKS is not set
# CONFIG_CMD_ELF is not set
CONFIG_CMD_MEMINFO=y
CONFIG_CMD_MEMTEST=y
# CONFIG_CMD_UNLZ4 is not set
# CONFIG_CMD_UNZIP is not set
CONFIG_CMD_GPIO=y
CONFIG_CMD_GPIO_READ=y
CONFIG_CMD_PWM=y
CONFIG_CMD_GPT=y
CONFIG_CMD_GPT_RENAME=y
CONFIG_CMD_LSBLK=y
CONFIG_CMD_MMC=y
CONFIG_CMD_PART=y
CONFIG_CMD_READ=y
CONFIG_CMD_TFTPPUT=y
CONFIG_CMD_PING=y
CONFIG_CMD_SMC=y
CONFIG_CMD_FAT=y
CONFIG_CMD_FS_GENERIC=y
CONFIG_CMD_GL_BTN=y
CONFIG_PARTITION_TYPE_GUID=y
CONFIG_OF_EMBED=y
CONFIG_ENV_OVERWRITE=y
CONFIG_ENV_IS_IN_MMC=y
CONFIG_ENV_VARS_UBOOT_RUNTIME_CONFIG=y
CONFIG_ENV_IMPORT_FDT=y
CONFIG_NET_RANDOM_ETHADDR=y
CONFIG_USE_IPADDR=y
CONFIG_IPADDR="192.168.1.1"
CONFIG_USE_NETMASK=y
CONFIG_NETMASK="255.255.255.0"
CONFIG_USE_SERVERIP=y
CONFIG_SERVERIP="192.168.1.2"
CONFIG_PROT_TCP=y
CONFIG_REGMAP=y
CONFIG_SYSCON=y
CONFIG_BUTTON=y
CONFIG_BUTTON_GPIO=y
CONFIG_CLK=y
CONFIG_LED=y
CONFIG_LED_BLINK=y
CONFIG_LED_GPIO=y
CONFIG_MMC_MTK=y
CONFIG_PHY_FIXED=y
CONFIG_MEDIATEK_ETH=y
CONFIG_PINCTRL=y
CONFIG_PINCONF=y
CONFIG_PINCTRL_MT7981=y
CONFIG_POWER_DOMAIN=y
CONFIG_MTK_POWER_DOMAIN=y
CONFIG_DM_REGULATOR=y
CONFIG_DM_REGULATOR_FIXED=y
CONFIG_DM_REGULATOR_GPIO=y
CONFIG_DM_PWM=y
CONFIG_PWM_MTK=y
CONFIG_DM_SERIAL=y
CONFIG_MTK_SERIAL=y
CONFIG_TIMER=y
CONFIG_MTK_TIMER=y
CONFIG_FAT_WRITE=y
CONFIG_HEXDUMP=y
# CONFIG_EFI_LOADER is not set
CONFIG_LMB_MAX_REGIONS=64
# CONFIG_PCI is not set
# CONFIG_CMD_XIMG is not set
CONFIG_CMD_BOOTMENU=y
# CONFIG_CMD_PCI is not set
# CONFIG_SYS_I2C_MTK is not set
CONFIG_CMD_LED_BLINK=y
CONFIG_MMC_HS200_SUPPORT=y
CONFIG_DM_ETH=y
# CONFIG_PCIE_MEDIATEK is not set
CONFIG_POLLER=y
```

## uboot-mtk-20250711/configs/mt7981_wr30u_defconfig
```kconfig
CONFIG_ARM=y
CONFIG_SYS_HAS_NONCACHED_MEMORY=y
CONFIG_POSITION_INDEPENDENT=y
CONFIG_ARCH_MEDIATEK=y
CONFIG_TEXT_BASE=0x41e00000
CONFIG_SYS_MALLOC_F_LEN=0x4000
CONFIG_NR_DRAM_BANKS=1
CONFIG_ENV_SIZE=0x10000
CONFIG_ENV_OFFSET=0x0
CONFIG_DEFAULT_DEVICE_TREE="mt7981-wr30u"
CONFIG_SYS_PROMPT="MT7981> "
CONFIG_TARGET_MT7981=y
CONFIG_DEBUG_UART_BASE=0x11002000
CONFIG_DEBUG_UART_CLOCK=40000000
CONFIG_SYS_LOAD_ADDR=0x46000000
CONFIG_DEBUG_UART=y
CONFIG_MEDIATEK_BOOTMENU=y
CONFIG_MEDIATEK_BOOTMENU_DELAY=3
CONFIG_MTK_WEB_FAILSAFE=y
CONFIG_MTK_WEB_FAILSAFE_AFTER_BOOT_FAILURE=y
CONFIG_MTK_UBI_SUPPORT=y
CONFIG_MTK_UPGRADE_BL2_VERIFY=y
# CONFIG_MTK_UPGRADE_IMAGE_VERIFY is not set
CONFIG_ENABLE_NAND_NMBM=y
CONFIG_FIT=y
CONFIG_AUTOBOOT_MENU_SHOW=y
CONFIG_AUTOBOOT_MENU_MTK_SHOW=y
CONFIG_DEFAULT_FDT_FILE="mt7981-spim-nand-rfb"
CONFIG_LOGLEVEL=7
CONFIG_LOG=y
CONFIG_HUSH_PARSER=y
CONFIG_SYS_CBSIZE=512
CONFIG_SYS_PBSIZE=1049
# CONFIG_BOOTM_NETBSD is not set
# CONFIG_BOOTM_PLAN9 is not set
# CONFIG_BOOTM_RTEMS is not set
# CONFIG_BOOTM_VXWORKS is not set
# CONFIG_CMD_ELF is not set
CONFIG_CMD_MEMINFO=y
# CONFIG_CMD_UNLZ4 is not set
# CONFIG_CMD_UNZIP is not set
CONFIG_CMD_GPIO=y
CONFIG_CMD_GPIO_READ=y
CONFIG_CMD_PWM=y
CONFIG_CMD_MTD=y
CONFIG_CMD_NMBM=y
CONFIG_CMD_TFTPPUT=y
CONFIG_CMD_PING=y
CONFIG_CMD_SMC=y
CONFIG_CMD_MTDPARTS=y
CONFIG_MTDIDS_DEFAULT="nmbm0=nmbm0"
CONFIG_MTDPARTS_DEFAULT="nmbm0:1024k(bl2),256k(Nvram),256k(Bdata),2048k(factory),2048k(fip),256k(crash),256k(crash_log),112m(ubi),256k(KF)"
CONFIG_CMD_GL_BTN=y
CONFIG_OF_EMBED=y
CONFIG_ENV_OVERWRITE=y
CONFIG_ENV_IS_IN_MTD=y
CONFIG_ENV_MTD_NAME="Nvram"
CONFIG_ENV_SIZE_REDUND=0x80000
CONFIG_ENV_VARS_UBOOT_RUNTIME_CONFIG=y
CONFIG_NET_RANDOM_ETHADDR=y
CONFIG_USE_IPADDR=y
CONFIG_IPADDR="192.168.1.1"
CONFIG_USE_NETMASK=y
CONFIG_NETMASK="255.255.255.0"
CONFIG_USE_SERVERIP=y
CONFIG_SERVERIP="192.168.1.2"
CONFIG_PROT_TCP=y
CONFIG_REGMAP=y
CONFIG_SYSCON=y
CONFIG_BUTTON=y
CONFIG_BUTTON_GPIO=y
CONFIG_CLK=y
# CONFIG_I2C is not set
CONFIG_LED=y
CONFIG_LED_BLINK=y
CONFIG_LED_GPIO=y
# CONFIG_MMC is not set
CONFIG_DM_MTD=y
CONFIG_MTD_SPI_NAND=y
CONFIG_PHY_FIXED=y
CONFIG_MEDIATEK_ETH=y
CONFIG_PINCTRL=y
CONFIG_PINCONF=y
CONFIG_PINCTRL_MT7981=y
CONFIG_POWER_DOMAIN=y
CONFIG_MTK_POWER_DOMAIN=y
CONFIG_DM_REGULATOR=y
CONFIG_DM_REGULATOR_FIXED=y
CONFIG_DM_REGULATOR_GPIO=y
CONFIG_DM_PWM=y
CONFIG_PWM_MTK=y
CONFIG_DM_SERIAL=y
CONFIG_MTK_SERIAL=y
CONFIG_SPI=y
CONFIG_DM_SPI=y
CONFIG_MTK_SPIM=y
CONFIG_TIMER=y
CONFIG_MTK_TIMER=y
CONFIG_HEXDUMP=y
CONFIG_MD5=y
# CONFIG_CMD_XIMG is not set
CONFIG_CMD_BOOTMENU=y
CONFIG_ENV_MTD_DEV="Nvram"
# CONFIG_DM_I2C is not set
# CONFIG_I2C_SET_DEFAULT_BUS_NUM is not set
# CONFIG_PCIE_MEDIATEK is not set
# CONFIG_EFI_LOADER is not set
```

## uboot-mtk-20250711/drivers/net/phy/mediatek/Kconfig
```kconfig
# SPDX-License-Identifier: GPL-2.0-only
config MTK_NET_PHYLIB
	tristate

config PHY_MEDIATEK_2P5GE
	tristate "MediaTek 2.5Gb Ethernet PHYs"
	depends on OF_CONTROL
	select MTK_NET_PHYLIB
	help
	  Supports MediaTek SoC built-in 2.5Gb Ethernet PHYs.

	  This will load necessary firmware and add appropriate time delay.
	  Accelerate this procedure through internal pbus instead of MDIO
	  bus. Certain link-up issues will also be fixed here.
```
