## uboot-mtk-20230718-09eda825/board/mediatek/Kconfig
```kconfig
if ARCH_MEDIATEK || ARCH_MTMIPS

menu "MediaTek specific configurations"

menuconfig MEDIATEK_BOOTMENU
	bool "Enable bootmenu framework"
	select CMD_BOOTMENU
	select CMD_BOOTMENU_ENTER_UBOOT_CONSOLE
	select PARTITIONS
	default n
	help
	  Enable this option will allow boards to use a bootmenu containing
	  features for easy upgrading/booting.

if MEDIATEK_BOOTMENU

config MTK_BOOTMENU_DEFAULT
	bool "Use default bootmenu"
	default y
	help
	  Enable this is you want to use default bootmenu. Otherwise you must
	  provide your own bootmenu implementation.

choice
	prompt "Device type for bootmenu"
	default MTK_BOOTMENU_MTD
	depends on MTK_BOOTMENU_DEFAULT

config MTK_BOOTMENU_MTD
	bool "MTD (NOR/NAND/UBI)"
	select MTD
	select MTD_PARTITIONS
	help
	  This is intended for raw flashes (e.g. SPI-NOR and SPI-NAND). Both
	  raw jffs2 images and UBI-based images which are built on top of MTD
	  are supported.

	  To enable legacy raw jffs2 support (not recommended), please define
	  mtdparts to contain a partition named 'firmware', and do not create
	  any partition named 'kernel' or 'ubi'.

	  To enable UBI-based image support, please select MTK_UBI_SUPPORT
	  first, and define mtdparts to contain a partition named 'ubi', and do
	  not create any partition named 'kernel' or 'firmware'.

config MTK_BOOTMENU_MTD_LEGACY
	bool "MTD (NOR/NAND/UBI) legacy"
	select MTD
	select MTD_PARTITIONS
	depends on ARCH_MTMIPS || TARGET_MT7629
	help
	  Similar to MTK_BOOTMENU_MTD, but single bootloader is used.
	  e.g., MIPS platform, or ARMv7 without ATF.

config MTK_BOOTMENU_MMC
	bool "SD/eMMC"
	select MMC
	select MMC_WRITE
	select MMC_HW_PARTITIONING
	select SUPPORT_EMMC_BOOT
	help
	  This is intended SD and eMMC. GPT partition table must define two
	  partitions 'kernel' and 'rootfs' to support this image type.
	  Only upgrade images using tar archive are supported.

endchoice

config MTK_MMC_BOOT_BUS_WIDTH_1B
	bool
	default y if TARGET_MT7622
	default n

config MTK_FIXED_MTD_MTDPARTS
	bool "Do not allow mtdparts to be changed by user"
	depends on MTK_BOOTMENU_MTD
	help
	  Enable this option if you do not want the user to change the
	  mtdparts which lead to unexpceted results such as missing ubi
	  partition or changing ubi partition to a different offset.

config MTK_BOOTMENU_MMC_DEV_INDEX
	int "MMC device for bootmenu"
	range 0 1
	default 0
	depends on MTK_BOOTMENU_MMC
	help
	  The MMC device id in u-boot to be used for bootmenu.

config MEDIATEK_BOOTMENU_COUNTDOWN
	bool "Enable bootmenu countdown"
	default y
	help
	  Enable bootmenu auto-booting countdown timer.

config MEDIATEK_BOOTMENU_DELAY
	int "MediaTek bootmenu delay time (s)"
	range 1 10
	default 4
	depends on MEDIATEK_BOOTMENU_COUNTDOWN
	help
	  The dealy seconds for the bootmenu to show before running the
	  default command.

config MTK_LOAD_FROM_SD
	bool "Enable support for loading from SD card"
	default n
	select FS_FAT
	select PARTITIONS
	select DOS_PARTITION
	select EFI_PARTITION
	select HAVE_BLK
	depends on DM_MMC
	help
	  Enable support for loading from SD card for mtkload and mtkupgrade.

config MTK_SD_DEV_IDX
	int "MMC device index for SD card"
	range 0 1
	default 1 if TARGET_MT7622
	default 0
	depends on MTK_LOAD_FROM_SD
	help
	  The MMC device index used for SD card loading.

config MEDIATEK_LOAD_FROM_RAM
	bool "Enable loading from RAM support"
	default n
	help
	  Enable loading from RAM support for mtkload and mtkupgrade. This is
	  useful when using JTAG debugging and ethernet is not available.

config MTK_WEB_FAILSAFE
	bool "Enable Web-based failsafe for firmware upgrading"
	default n
	select WEBUI_FAILSAFE
	help
	  Enable Web-based failsafe for firmware upgrading. A bootmenu item
	  will be added to allow entering failsafe mode.

config MTK_WEB_FAILSAFE_AFTER_BOOT_FAILURE
	bool "Automatically start failsafe after booting failure"
	default n
	depends on MTK_WEB_FAILSAFE
	help
	  This option allow user to upgrade a workable firmware image if no
	  firmware image available for boot.
	  This requires booting system using mtkboardboot command.

config MTK_UBI_SUPPORT
	bool "Enable support for UBI-based images"
	select MTD_UBI
	select CMD_UBI
	help
	   Enable this option will allow bootmenu for mtd using UBI-based
	   images for upgrading and booting.

endif # MEDIATEK_BOOTMENU

menuconfig MTK_SECURE_BOOT
	bool "Enable secure boot framework"
	select FIT_SIGNATURE
	select RSA
	select RSA_VERIFY
	select ENV_IS_NOWHERE if !MTK_DUAL_BOOT
	select CHAIN_OF_TRUST if !MTK_DUAL_BOOT
	select IMAGE_FORCED_VERIFY
	select FDT_NO_BOOTARGS_OVERRIDE
	depends on ARCH_MEDIATEK
	default n
	help
	  Enable this option will allow boards to verify Linux and Filesystem.

if MTK_SECURE_BOOT

config CHAIN_OF_TRUST
	bool
	default n

config MTK_ANTI_ROLLBACK
	bool "Enable MediaTek anti-rollback framework"
	default n
	help
	  Enable this option will allow boards to verify Firmware Anti-rollback
	  Version.

config MTK_FSEK
	bool "Enable MediaTek FS encryption key framework"
	default n
	help
	  Enable this option will allow boards to decrypt rootfs-key and set
	  roofs-key to kernel bootargs, and set a device-unique key in FDT

choice
	prompt "Device type for secure environment variables"
	default MTK_SEC_ENV_MTD
	depends on MTK_FSEK

config MTK_SEC_ENV_MTD
	bool "MTD(NOR/NAND/UBI)"
	depends on MTK_BOOTMENU_MTD
	help
	This is intended for raw flashes (e.g. SPI-NOR and SPI-NAND).

config MTK_SEC_ENV_MMC
	bool "SD/eMMC"
	depends on MTK_BOOTMENU_MMC
	help
	  This is intended SD and eMMC.
endchoice

endif # MTK_SECURE_BOOT

menuconfig MTK_DUAL_BOOT
	bool "Enable A/B System Updates"
	help
	  A/B system updates ensure a workable booting system remains on the
	  flash device during an firmware upgrading.

if MTK_DUAL_BOOT

config MTK_DUAL_BOOT_IMAGE_ROOTFS_VERIFY
	bool "Verify rootfs part"
	default y
	help
	  Enable this option will force to verify the rootfs part of the image.
	  The rootfs hash should be embedded into the FIT image.
	  If no such hash found, verification will fail.

config MTK_DUAL_BOOT_SLOT_1_KERNEL_NAME
	string "Name for kernel of image slot 1"
	default "kernel2"
	help
	  The partition/volume name for kernel of image slot 1

config MTK_DUAL_BOOT_SLOT_1_ROOTFS_NAME
	string "Name for rootfs of image slot 1"
	default "rootfs2"
	help
	  The partition/volume name for rootfs of image slot 1

config MTK_DUAL_BOOT_SHARED_ROOTFS_DATA
	bool "Use shared rootfs_data for both images"
	default y

config MTK_DUAL_BOOT_ROOTFS_DATA_NAME
	string "Name for rootfs_data of both image slots"
	depends on MTK_DUAL_BOOT_SHARED_ROOTFS_DATA
	default "rootfs_data"

config MTK_DUAL_BOOT_ROOTFS_DATA_SIZE
	int "Size of rootfs_data volume (MiB)"
	range 1 128
	default 8
	depends on MTK_DUAL_BOOT_SHARED_ROOTFS_DATA
	depends on MTD_UBI

config MTK_DUAL_BOOT_RESERVE_ROOTFS_DATA
	bool "Reserve rootfs_data during firmware upgrading"
	default n
	help
	  Enable this option will make rootfs_data completely untouched
	  during OpenWrt sysupgrade, even if 'keep settings' is deselected.

endif # MTK_DUAL_BOOT

if ARCH_MEDIATEK

config MTK_BOARDINFO
	bool "Enable mediatek boardinfo support"
	default n
	help
	  Enable this option will allow mediatek boards to show extend
	  information when boot-up.

config MTK_FIP_SUPPORT
	bool "Enable ATF FIP utilities"
	select MTK_BOARDINFO
	default n
	help
	  Enable this option will allow boards to use ATF related
	  firmware image package (FIP) commands and APIs.

config MTK_UPGRADE_BL2_VERIFY
	bool "Verify bl2 image before upgrading"
	select MTK_BOARDINFO
	default n
	help
	  Enable this option will force to verify the BL2 image being
	  upgraded when 'bl2_verify' node is configured in the device tree.
	  Upgrading broken BL2 image and the image that is not suitable for
	  the current flash type will be rejected.

config MTK_UPGRADE_FIP_VERIFY
	bool "Verify fip image before upgrading"
	select MTK_FIP_SUPPORT
	default n
	help
	  Enable this option will force to verify the FIP image being
	  upgraded. Upgrading broken FIP image and the image that is not
	  suitable for the current flash type will be rejected.

endif # ARCH_MEDIATEK

config MTK_UPGRADE_IMAGE_VERIFY
	bool "Verify firmware image before upgrading"
	select FIT
	default y
	help
	  Enable this option will force to verify the image being upgraded.
	  Upgrading UBI raw partition image and UBI hybrid image will be
	  rejected.

config MTK_UPGRADE_IMAGE_LEGACY_VERIFY
	bool "Allow verifying legacy image"
	depends on ARCH_MTMIPS
	select LEGACY_IMAGE_FORMAT
	default n
	help
	  Enable this option will allow legacy image be upgraded. Only kernel
	  portion of the image can be verified.

config MTK_UPGRADE_IMAGE_ROOTFS_VERIFY
	bool "Verify rootfs part"
	depends on MTK_UPGRADE_IMAGE_VERIFY
	default y if MTK_DUAL_BOOT
	default n
	help
	  Enable this option will force to verify the rootfs part of the image.
	  The rootfs hash should be embedded into the FIT image.
	  If no such hash found, verification will fail.

config ENABLE_NAND_NMBM
	bool "Enable NAND bad block mapping management"
	default n
	select MTD_DEVICE
	select NMBM
	select NMBM_MTD
	help
	  Select this if you want to use bad block management to handle
	  bad blocks marked druing factory production, and to handle new
	  bad blocks during use.
	  Enabling this option will create a MTD translation layer on
	  the original MTD of the NAND device.

if ENABLE_NAND_NMBM

config NMBM_LOWER_MTD
	string "Lower MTD device name"
	default "spi-nand0"
	help
	  The name of lower mtd device on which nmbm will be created

config NMBM_MAX_RATIO
	int "Default ratio for reserved block for management (N/16)"
	range 1 8
	default 1
	help
	  This option determines how many blocks at the high adress of NAND
	  can be used for NMBM. For a large size NAND, 1/16 of total blocks
	  are still too large for NMBM. For this situation please set
	  CONFIG_NMBM_MAX_BLOCKS to a proper value to limit the maximum
	  reserved blocks.

config NMBM_MAX_BLOCKS
	int "Maximum blocks allowed for reserved block for management"
	range 32 2147483647
	default 256
	help
	  This option is applied after NMBM_MAX_RATIO to ensure maximum
	  blocks reserved block for NMBM will not exceed the value set by
	  this option.

endif # ENABLE_NAND_NMBM

source "board/mediatek/common/customizations/Kconfig"

endmenu

endif # ARCH_MEDIATEK
```

## uboot-mtk-20230718-09eda825/configs/mt7621_ax_rfb_defconfig
```kconfig
CONFIG_MIPS=y
CONFIG_SYS_HAS_NONCACHED_MEMORY=y
CONFIG_SYS_MALLOC_LEN=0x100000
CONFIG_SPL_LIBCOMMON_SUPPORT=y
CONFIG_SPL_LIBGENERIC_SUPPORT=y
CONFIG_NR_DRAM_BANKS=1
CONFIG_SF_DEFAULT_SPEED=20000000
CONFIG_ENV_SIZE=0x10000
CONFIG_ENV_OFFSET=0x0
CONFIG_DEFAULT_DEVICE_TREE="mediatek,mt7621-rfb"
CONFIG_SPL_SERIAL=y
CONFIG_TPL_SYS_MALLOC_F_LEN=0x1000
CONFIG_SPL_SYS_MALLOC_F_LEN=0x40000
CONFIG_SPL=y
CONFIG_DEBUG_UART_BASE=0xbe000c00
CONFIG_DEBUG_UART_CLOCK=50000000
CONFIG_SYS_LOAD_ADDR=0x83000000
CONFIG_ARCH_MTMIPS=y
CONFIG_SOC_MT7621=y
CONFIG_SYS_MIPS_TIMER_FREQ=440000000
# CONFIG_MIPS_CACHE_SETUP is not set
# CONFIG_MIPS_CACHE_DISABLE is not set
CONFIG_RESTORE_EXCEPTION_VECTOR_BASE=y
CONFIG_MIPS_BOOT_FDT=y
CONFIG_DEBUG_UART=y
CONFIG_MEDIATEK_BOOTMENU=y
CONFIG_MTK_BOOTMENU_MTD_LEGACY=y
CONFIG_MTK_UPGRADE_IMAGE_LEGACY_VERIFY=y
# CONFIG_ARCH_FIXUP_FDT_MEMORY is not set
CONFIG_AUTOBOOT_MENU_SHOW=y
CONFIG_AUTOBOOT_MENU_MTK_SHOW=y
CONFIG_SYS_CONSOLE_INFO_QUIET=y
CONFIG_SPL_MAX_SIZE=0x30000
CONFIG_SPL_BSS_START_ADDR=0x80140000
CONFIG_SPL_BSS_MAX_SIZE=0x80000
CONFIG_SPL_SYS_MALLOC_SIMPLE=y
CONFIG_SPL_NOR_SUPPORT=y
CONFIG_TPL=y
# CONFIG_TPL_FRAMEWORK is not set
# CONFIG_BOOTM_NETBSD is not set
# CONFIG_BOOTM_PLAN9 is not set
# CONFIG_BOOTM_RTEMS is not set
# CONFIG_BOOTM_VXWORKS is not set
CONFIG_SYS_BOOTM_LEN=0x2000000
# CONFIG_CMD_ELF is not set
# CONFIG_CMD_XIMG is not set
# CONFIG_CMD_CRC32 is not set
# CONFIG_CMD_DM is not set
CONFIG_CMD_GPIO=y
# CONFIG_CMD_LOADS is not set
CONFIG_CMD_MTD=y
# CONFIG_CMD_PINMUX is not set
CONFIG_CMD_SPI=y
# CONFIG_CMD_NFS is not set
CONFIG_MTDIDS_DEFAULT="nor0=nor0"
CONFIG_MTDPARTS_DEFAULT="nor0:256k(u-boot),64k(u-boot-env),256k(factory),-(firmware)"
# CONFIG_ISO_PARTITION is not set
CONFIG_ENV_IS_IN_MTD=y
CONFIG_ENV_MTD_NAME="u-boot-env"
CONFIG_ENV_SIZE_REDUND=0x0
CONFIG_SYS_RELOC_GD_ENV_ADDR=y
CONFIG_NET_RANDOM_ETHADDR=y
CONFIG_USE_IPADDR=y
CONFIG_IPADDR="192.168.1.1"
CONFIG_USE_NETMASK=y
CONFIG_NETMASK="255.255.255.0"
CONFIG_USE_SERVERIP=y
CONFIG_SERVERIP="192.168.1.2"
# CONFIG_I2C is not set
# CONFIG_INPUT is not set
CONFIG_SPI_FLASH_BAR=y
CONFIG_SPI_FLASH_EON=y
CONFIG_SPI_FLASH_GIGADEVICE=y
CONFIG_SPI_FLASH_ISSI=y
CONFIG_SPI_FLASH_MACRONIX=y
CONFIG_SPI_FLASH_SPANSION=y
CONFIG_SPI_FLASH_STMICRO=y
CONFIG_SPI_FLASH_WINBOND=y
CONFIG_SPI_FLASH_XMC=y
CONFIG_SPI_FLASH_XTX=y
CONFIG_SPI_FLASH_MTD=y
CONFIG_MEDIATEK_ETH=y
CONFIG_PHY=y
CONFIG_PHY_MTK_TPHY=y
CONFIG_DEBUG_UART_SHIFT=2
CONFIG_SPI=y
CONFIG_MT7621_SPI=y
CONFIG_SYSRESET=y
CONFIG_SYSRESET_RESETCTL=y
CONFIG_WDT=y
CONFIG_WDT_MT7621=y
# CONFIG_BINMAN_FDT is not set
CONFIG_LZMA=y
# CONFIG_GZIP is not set
CONFIG_SPL_LZMA=y
```

## uboot-mtk-20230718-09eda825/configs/mt7622_nor_rfb_defconfig
```kconfig
CONFIG_ARM=y
CONFIG_SYS_HAS_NONCACHED_MEMORY=y
CONFIG_POSITION_INDEPENDENT=y
CONFIG_ARCH_MEDIATEK=y
CONFIG_TEXT_BASE=0x41e00000
CONFIG_SYS_MALLOC_F_LEN=0x4000
CONFIG_NR_DRAM_BANKS=1
CONFIG_ENV_SIZE=0x10000
CONFIG_ENV_OFFSET=0x0
CONFIG_DEFAULT_DEVICE_TREE="mt7622-rfb"
CONFIG_SYS_PROMPT="MT7622> "
CONFIG_DEBUG_UART_BASE=0x11002000
CONFIG_DEBUG_UART_CLOCK=25000000
CONFIG_SYS_LOAD_ADDR=0x4007ff28
CONFIG_MEDIATEK_BOOTMENU=y
CONFIG_DEBUG_UART=y
CONFIG_AUTOBOOT_MENU_SHOW=y
CONFIG_AUTOBOOT_MENU_MTK_SHOW=y
CONFIG_DEFAULT_FDT_FILE="mt7622-rfb"
CONFIG_LOGLEVEL=7
CONFIG_LOG=y
CONFIG_SYS_CBSIZE=512
CONFIG_SYS_PBSIZE=1049
# CONFIG_BOOTM_NETBSD is not set
# CONFIG_BOOTM_PLAN9 is not set
# CONFIG_BOOTM_RTEMS is not set
# CONFIG_BOOTM_VXWORKS is not set
# CONFIG_CMD_ELF is not set
CONFIG_CMD_DM=y
# CONFIG_CMD_FLASH is not set
CONFIG_CMD_GPIO=y
CONFIG_CMD_MMC=y
CONFIG_CMD_MTD=y
CONFIG_CMD_PCI=y
CONFIG_CMD_SF_TEST=y
CONFIG_CMD_PING=y
CONFIG_CMD_SMC=y
CONFIG_MTDIDS_DEFAULT="nor0=nor0"
CONFIG_MTDPARTS_DEFAULT="nor0:128k(bl2),2048k(fip),64k(u-boot-env),256k(factory),-(firmware)"
CONFIG_DOS_PARTITION=y
CONFIG_EFI_PARTITION=y
CONFIG_PARTITION_TYPE_GUID=y
CONFIG_ENV_OVERWRITE=y
CONFIG_ENV_IS_IN_MTD=y
CONFIG_ENV_MTD_NAME="u-boot-env"
CONFIG_ENV_SIZE_REDUND=0x10000
CONFIG_ENV_VARS_UBOOT_RUNTIME_CONFIG=y
CONFIG_NET_RANDOM_ETHADDR=y
CONFIG_USE_IPADDR=y
CONFIG_IPADDR="192.168.1.1"
CONFIG_USE_NETMASK=y
CONFIG_NETMASK="255.255.255.0"
CONFIG_USE_SERVERIP=y
CONFIG_SERVERIP="192.168.1.2"
CONFIG_REGMAP=y
CONFIG_SYSCON=y
CONFIG_CLK=y
CONFIG_MMC_HS200_SUPPORT=y
CONFIG_MMC_MTK=y
CONFIG_DM_MTD=y
CONFIG_DM_SPI_FLASH=y
CONFIG_SPI_FLASH_SFDP_SUPPORT=y
CONFIG_SPI_FLASH_EON=y
CONFIG_SPI_FLASH_GIGADEVICE=y
CONFIG_SPI_FLASH_ISSI=y
CONFIG_SPI_FLASH_MACRONIX=y
CONFIG_SPI_FLASH_SPANSION=y
CONFIG_SPI_FLASH_STMICRO=y
CONFIG_SPI_FLASH_WINBOND=y
CONFIG_SPI_FLASH_XMC=y
CONFIG_SPI_FLASH_MTD=y
CONFIG_PHY_FIXED=y
CONFIG_MEDIATEK_ETH=y
CONFIG_PCI=y
CONFIG_PCIE_MEDIATEK=y
CONFIG_PINCTRL=y
CONFIG_PINCONF=y
CONFIG_PINCTRL_MT7622=y
CONFIG_POWER_DOMAIN=y
CONFIG_MTK_POWER_DOMAIN=y
CONFIG_RAM=y
CONFIG_DM_SERIAL=y
CONFIG_MTK_SERIAL=y
CONFIG_SPI=y
CONFIG_DM_SPI=y
CONFIG_MTK_SNOR=y
CONFIG_LZO=y
CONFIG_HEXDUMP=y
# CONFIG_EFI_LOADER is not set
```
