// SPDX-License-Identifier: GPL-2.0

#include "mt7987a-rfb-u-boot.dtsi"

/ {
	model = "mt7987";
	compatible = "mediatek,mt7987", "mediatek,mt7987-spim-nor-rfb";

	bl2_verify {
		bl2_compatible = "spim-nor";
	};
};

&spi0 {
	status = "disabled";
};
