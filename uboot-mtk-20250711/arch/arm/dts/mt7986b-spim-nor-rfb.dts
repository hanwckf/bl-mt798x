// SPDX-License-Identifier: GPL-2.0
/*
 * Copyright (c) 2022 MediaTek Inc.
 * Author: Sam Shih <sam.shih@mediatek.com>
 */

/dts-v1/;
#include "mt7986b-rfb.dts"

/ {
	compatible = "mediatek,mt7986", "mediatek,mt7986-rfb",
		     "mediatek,mt7986-spim-nor-rfb";
	bl2_verify {
		bl2_compatible = "spim-nor";
	};
};
