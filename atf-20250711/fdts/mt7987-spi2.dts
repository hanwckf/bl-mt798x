// SPDX-License-Identifier: BSD-3-Clause
/*
 * Copyright (c) 2024, MediaTek Inc. All rights reserved.
 */
/dts-v1/;

/ {
	soc {
		#address-cells = <1>;
		#size-cells = <1>;

		qspi: spi@11009800 {
			compatible = "mediatek,ipm-spi";
			#address-cells = <1>;
			#size-cells = <0>;
			reg = <0x11009800 0x1000>;
			status = "okay";

			flash0: spiflash@0 {
				compatible = "spi-flash";
				reg = <0>;
				spi-tx-bus-width = <4>;
				spi-rx-bus-width = <4>;
				spi-cpol = <1>;
				spi-cpha = <1>;
				tick-dly = <2>;
				spi-max-frequency = <52000000>;
				#address-cells = <1>;
				#size-cells = <1>;
			};
		};
	};
};
